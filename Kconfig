## Kconfig
```kconfig
mainmenu "ai-stack configuration"

menu "General"

config DATA_DIR
	string "Data directory for persistent volumes"
	default "/data/ai-stack"
	help
	  Directory where persistent container data (OpenWebUI data) is
	  stored.

config SYSTEM_USER
	string "System username for ai-stack services"
	default "aistack"
	help
	  All containers run under this user's UID/GID. If the user does not
	  already exist, 'make config' will offer to create it.

config BIND_HOST
	string "Host address services bind to"
	default "127.0.0.1"
	help
	  Loopback address all service ports are published on. Nginx
	  reverse-proxies LAN traffic to these loopback ports.

endmenu

menu "llama"

config LLAMA_VERSION
	string "llama.cpp git tag/branch to build"
	default "b11375"
	help
	  Git tag/branch the llama-cpp-rocm:latest image is built from.
	  Qwen3.8-Flash-Next (qwen4exp) needs b11375 or later.

config MODELS_DIR
	string "GGUF model files directory"
	default "/data/models/llamacpp"
	help
	  Bind-mounted read-only into llama.

menu "GPU(s) exposed to llama"

comment "Detected by rocminfo when 'make menuconfig' starts"

source "$(BASE_DIR)/Kconfig.gpus"

config GPU_DEVICES_EXTRA
	string "Extra GPU UUIDs (comma-separated, optional)"
	default ""
	help
	  Appended to the GPUs checked above; the combined comma-separated
	  list becomes ROCR_VISIBLE_DEVICES for the llama container. Only needed
	  when rocminfo isn't installed or doesn't list a card. Use UUIDs, not
	  indices: a UUID is a property of the card and survives reboots,
	  whereas an index is just KFD enumeration order. A card reporting
	  "GPU-XX" has no UUID (the integrated GPU is one) and isn't listed.

endmenu

config LLAMA_GPU_TARGETS
	string "GPU architecture(s) to compile llama.cpp for"
	default "$(GPU_ARCHS)"
	help
	  Semicolon-separated gfx targets passed to cmake's GPU_TARGETS by
	  'make build-llama' (e.g. gfx1100 for an RX 7900 XTX, gfx1201 for an
	  R9700 / RX 9070). Defaults to every architecture rocminfo reports
	  for the GPUs listed above. A GPU whose architecture isn't compiled
	  in fails with "ROCm error: invalid device function".

config LLAMA_PORT
	int "llama.cpp inference server host port"
	default 8082
	range 1 65535

config LLAMA_DOMAIN
	string "Nginx server_name for llama"
	default "model.cloud.home"

endmenu

menu "searxng"

config SEARXNG_PORT
	int "SearXNG host port"
	default 8888
	range 1 65535

config SEARXNG_SECRET
	string "SearXNG secret key"
	help
	  Used to sign SearXNG sessions. Generate with: openssl rand -hex 32

config DNS_SERVERS
	string "DNS server for the searxng container"
	default "1.1.1.1"

config SEARXNG_DOMAIN
	string "Nginx server_name for searxng"
	default "websearch.cloud.home"

endmenu

menu "openwebui"

config OPENWEBUI_PORT
	int "OpenWebUI host port"
	default 3000
	range 1 65535

config OPENWEBUI_DOMAIN
	string "Nginx server_name for openwebui"
	default "darwish.cloud.home"
	help
	  Also used as OpenWebUI's own CORS_ALLOW_ORIGIN, so the two never
	  drift out of sync.

endmenu

menu "one-search-mcp"

config ONESEARCH_MCP_PORT
	int "one-search-mcp host port"
	default 3002
	range 1 65535

config ONESEARCH_MCP_DOMAIN
	string "Nginx server_name for one-search-mcp"
	default "onesearch.cloud.home"

endmenu

menu "grafana-mcp"

config GRAFANA_MCP_PORT
	int "grafana-mcp host port"
	default 3003
	range 1 65535

config GRAFANA_MCP_DOMAIN
	string "Nginx server_name for grafana-mcp"
	default "grafana-mcp.cloud.home"

config GRAFANA_URL
	string "Grafana instance URL"
	default "http://grafana.cloud.home"

config GRAFANA_SERVICE_ACCOUNT_TOKEN
	string "Grafana service account token"
	help
	  Passed to grafana-mcp as GRAFANA_SERVICE_ACCOUNT_TOKEN.

config GRAFANA_MCP_SERVER_TOKEN
	string "grafana-mcp server auth token"
	help
	  Passed to grafana-mcp as MCP_GRAFANA_SERVER_TOKEN. Stored in
	  plaintext in .config and in /etc/ai-stack/ai-stack.conf, same as
	  the token above.

endmenu
```
